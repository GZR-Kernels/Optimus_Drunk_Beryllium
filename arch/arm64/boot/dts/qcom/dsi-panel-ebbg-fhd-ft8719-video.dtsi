/* Copyright (c) 2015, The Linux Foundation. All rights reserved.
 * Copyright (C) 2018 XiaoMi, Inc.
 *
 * This program is free software; you can redistribute it and/or modify
 * it under the terms of the GNU General Public License version 2 and
 * only version 2 as published by the Free Software Foundation.
 *
 * This program is distributed in the hope that it will be useful,
 * but WITHOUT ANY WARRANTY; without even the implied warranty of
 * MERCHANTABILITY or FITNESS FOR A PARTICULAR PURPOSE.  See the
 * GNU General Public License for more details.
 */

/*---------------------------------------------------------------------------
 * This file is autogenerated file using gcdb parser. Please do not edit it.
 * Update input XML file to add a new entry or update variable in this file
 * VERSION = "1.0"
 *---------------------------------------------------------------------------*/
&soc {
	dsi_ebbg_fhd_ft8719_video: qcom,mdss_dsi_ebbg_fhd_ft8719_video {
		    qcom,mdss-dsi-panel-name = "ebbg fhd video dsi panel";
			qcom,mdss-dsi-panel-id = < 0x00 >;
			qcom,mdss-dsi-panel-model = "EBBG FHD FT8719 VIDEO PANEL";
			qcom,mdss-dsi-panel-type = "dsi_video_mode";
			qcom,mdss-dsi-virtual-channel-id = < 0x00 >;
			qcom,mdss-dsi-stream = < 0x00 >;
			qcom,mdss-dsi-bpp = < 0x18 >;
			qcom,mdss-dsi-color-order = "rgb_swap_rgb";
			qcom,mdss-dsi-underflow-color = < 0x00 >;
			qcom,mdss-dsi-border-color = < 0x00 >;
			qcom,mdss-dsi-traffic-mode = "burst_mode";
			qcom,mdss-dsi-bllp-eof-power-mode;
			qcom,mdss-dsi-bllp-power-mode;
			qcom,mdss-dsi-lp11-init;
			qcom,mdss-dsi-lane-0-state;
			qcom,mdss-dsi-lane-1-state;
			qcom,mdss-dsi-lane-2-state;
			qcom,mdss-dsi-lane-3-state;
			qcom,mdss-dsi-bl-min-level = < 0x01 >;
			qcom,mdss-dsi-bl-max-level = < 0xfff >;
			qcom,mdss-brightness-max-level = < 0xfff >;
			qcom,mdss-dsi-dma-trigger = "trigger_sw";
			qcom,mdss-dsi-mdp-trigger = "none";
			qcom,mdss-dsi-reset-sequence = < 0x01 0x04 0x00 0x01 0x01 0x0f >;
			qcom,mdss-pan-physical-width-dimension = < 0x44 >;
			qcom,mdss-pan-physical-height-dimension = < 0x8d >;
			qcom,cont-splash-enabled;
			qcom,mdss-dsi-tx-eot-append;
			qcom,mdss-dsi-panel-hdr-enabled;
			qcom,mdss-dsi-panel-hdr-color-primaries = < 0x38a4 0x3c8c 0x7d00 0x4268 0x3c8c 0x7530 0x1f40 0xbb8 >;
			qcom,mdss-dsi-panel-peak-brightness = < 0x401640 >;
			qcom,mdss-dsi-panel-blackness-level = < 0xc9e >;
			qcom,dispparam-enabled;
			qcom,mdss-panel-on-dimming-delay = < 0x78 >;
			qcom,mdss-dsi-t-clk-post = < 0x0e >;
			qcom,mdss-dsi-t-clk-pre = < 0x41 >;
			qcom,mdss-dsi-panel-status-check-mode = "reg_read";
			qcom,mdss-dsi-panel-status-command = < 0x6010001 0x10a 0x6010001 0x10b 0x6010001 0x10d >;
			qcom,mdss-dsi-panel-status-command-state = "dsi_hs_mode";
			qcom,mdss-dsi-panel-status-value = < 0x9c 0x00 0x00 >;
			qcom,mdss-dsi-panel-status-read-length = < 0x01 0x01 0x01 >;
			qcom,panel-supply-entries = < 0x360 >;
			qcom,mdss-dsi-bl-pmic-control-type = "bl_ctrl_wled";
			qcom,platform-reset-gpio = < 0x3c 0x06 0x00 >;

			qcom,mdss-dsi-display-timings {

				timing@0 {
					qcom,mdss-dsi-panel-framerate = < 0x3c >;
					qcom,mdss-dsi-panel-width = < 0x438 >;
					qcom,mdss-dsi-panel-height = < 0x8c6 >;
					qcom,mdss-dsi-h-front-porch = < 0x1c >;
					qcom,mdss-dsi-h-back-porch = < 0x10 >;
					qcom,mdss-dsi-h-pulse-width = < 0x04 >;
					qcom,mdss-dsi-h-sync-skew = < 0x00 >;
					qcom,mdss-dsi-v-back-porch = < 0x0c >;
					qcom,mdss-dsi-v-front-porch = < 0x78 >;
					qcom,mdss-dsi-v-pulse-width = < 0x04 >;
					qcom,mdss-dsi-h-left-border = < 0x00 >;
					qcom,mdss-dsi-h-right-border = < 0x00 >;
					qcom,mdss-dsi-v-top-border = < 0x00 >;
					qcom,mdss-dsi-v-bottom-border = < 0x00 >;
					qcom,mdss-dsi-on-command = [ 15 01 00 00 00 00 02 00 00 29 00 00 00 00 00 04 ff 87 19 01 15 00 00 00 00 00 02 00 80 29 01 00 00 00 00 03 ff 87 19 15 00 00 00 00 00 02 00 a0 29 00 00 00 00 00 04 ca 0f 0f 0f 15 00 00 00 00 00 02 00 80 29 00 00 00 00 00 0d ca be b5 ad a6 a0 9b 96 91 8d 8a 87 83 15 00 00 00 00 00 02 00 90 29 01 00 00 00 00 0a ca fe ff 66 f6 ff 66 fb ff 32 15 00 00 00 00 00 02 00 a0 29 00 00 00 00 00 0d d6 7a 79 74 8c 8c 92 97 9b 97 8f 80 77 15 00 00 00 00 00 02 00 b0 29 00 00 00 00 00 0d d6 7e 7d 81 7a 7a 7b 7c 81 84 85 80 82 15 00 00 00 00 00 02 00 c0 29 00 00 00 00 00 0d d6 7d 7d 78 8a 89 8f 97 97 8f 8c 80 7a 15 00 00 00 00 00 02 00 d0 29 01 00 00 00 00 0d d6 7e 7d 81 7c 79 7b 7c 80 84 85 80 82 15 00 00 00 00 00 02 00 e0 29 00 00 00 00 00 0d d6 7b 7b 7b 80 80 80 80 80 80 80 80 80 15 00 00 00 00 00 02 00 f0 29 00 00 00 00 00 0d d6 7e 7e 80 80 80 80 80 80 80 80 80 80 15 00 00 00 00 00 02 00 00 29 00 00 00 00 00 0d d7 80 80 80 80 80 80 80 80 80 80 80 80 15 00 00 00 00 00 02 00 10 29 01 00 00 00 00 0d d7 80 80 80 80 80 80 80 80 80 80 80 80 15 00 00 00 00 00 02 00 00 29 00 00 00 00 00 04 ff 00 00 00 15 00 00 00 00 00 02 00 80 29 01 00 00 00 00 03 ff 00 00 15 00 00 00 00 00 02 91 00 15 00 00 00 00 00 02 51 ff 15 00 00 00 00 00 02 53 24 15 00 00 00 00 00 02 55 00 05 01 00 00 5a 00 02 11 00 05 01 00 00 00 00 02 29 00 ];
					qcom,mdss-dsi-off-command = [ 05 01 00 00 0a 00 02 28 00 05 01 00 00 5a 00 02 10 00 ];
					qcom,mdss-dsi-on-command-state = "dsi_lp_mode";
					qcom,mdss-dsi-off-command-state = "dsi_hs_mode";
					qcom,mdss-dsi-h-sync-pulse = < 0x01 >;
					qcom,mdss-dsi-dispparam-cabcuion-command = [ 15 01 00 00 00 00 02 55 01 15 01 00 00 00 00 02 91 00 ];
					qcom,mdss-dsi-dispparam-cabcuion-command-state = "dsi_hs_mode";
					qcom,mdss-dsi-dispparam-cabcstillon-command = [ 15 01 00 00 00 00 02 55 02 15 01 00 00 00 00 02 91 00 ];
					qcom,mdss-dsi-dispparam-cabcstillon-command-state = "dsi_hs_mode";
					qcom,mdss-dsi-dispparam-cabcmovieon-command = [ 15 01 00 00 00 00 02 55 03 15 01 00 00 00 00 02 91 00 ];
					qcom,mdss-dsi-dispparam-cabcmovieon-command-state = "dsi_hs_mode";
					qcom,mdss-dsi-dispparam-cabcoff-command = [ 15 01 00 00 01 00 02 55 00 15 01 00 00 00 00 02 91 00 ];
					qcom,mdss-dsi-dispparam-cabcoff-command-state = "dsi_hs_mode";
					qcom,mdss-dsi-dispparam-dimmingon-command = [ 15 01 00 00 01 00 02 53 2c ];
					qcom,mdss-dsi-dispparam-dimmingon-command-state = "dsi_hs_mode";
					qcom,mdss-dsi-dispparam-ceon-command = [ 15 01 00 00 00 00 02 91 80 ];
					qcom,mdss-dsi-dispparam-ceon-command-state = "dsi_hs_mode";
					qcom,mdss-dsi-dispparam-ceoff-command = [ 15 01 00 00 00 00 02 91 00 ];
					qcom,mdss-dsi-dispparam-ceoff-command-state = "dsi_hs_mode";
					qcom,mdss-dsi-dispparam-skince-cabcuion-command = [ 15 01 00 00 00 00 02 55 01 15 01 00 00 00 00 02 91 80 ];
					qcom,mdss-dsi-dispparam-skince-cabcuion-command-state = "dsi_hs_mode";
					qcom,mdss-dsi-dispparam-skince-cabcstillon-command = [ 15 01 00 00 00 00 02 55 02 15 01 00 00 00 00 02 91 80 ];
					qcom,mdss-dsi-dispparam-skince-cabcstillon-command-state = "dsi_hs_mode";
					qcom,mdss-dsi-dispparam-skince-cabcmovieon-command = [ 15 01 00 00 00 00 02 55 03 15 01 00 00 00 00 02 91 80 ];
					qcom,mdss-dsi-dispparam-skince-cabcmovieon-command-state = "dsi_hs_mode";
					qcom,mdss-dsi-dispparam-skince-cabcoff-command = [ 15 01 00 00 01 00 02 55 00 15 01 00 00 00 00 02 91 80 ];
					qcom,mdss-dsi-dispparam-skince-cabcoff-command-state = "dsi_hs_mode";
					qcom,mdss-dsi-panel-phy-timings = < 0x210808 0x25220908 0x6030400 >;
					qcom,display-topology = < 0x01 0x00 0x01 >;
					qcom,default-topology-index = < 0x00 >;
			};
		};
	};
};
